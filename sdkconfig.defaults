## sdkconfig.defaults
```kconfig
# ESP32-C5-N16R8：16MB Flash + 8MB PSRAM
CONFIG_IDF_TARGET="esp32c5"
CONFIG_ESPTOOLPY_FLASHSIZE_16MB=y
CONFIG_SPIRAM=y

# 单核 240MHz；1kHz 系统节拍让跳频驻留和刷屏节奏更准
CONFIG_ESP_DEFAULT_CPU_FREQ_MHZ_240=y
CONFIG_FREERTOS_HZ=1000
CONFIG_ESP_MAIN_TASK_STACK_SIZE=4096

# Wi-Fi 协议栈 + LVGL 一起链接，1MB 的默认 app 分区不够用
CONFIG_PARTITION_TABLE_SINGLE_APP_LARGE=y

# 混杂模式丢帧主要发生在 RX 缓冲，默认 10/32 偏小
CONFIG_ESP_WIFI_STATIC_RX_BUFFER_NUM=16
CONFIG_ESP_WIFI_DYNAMIC_RX_BUFFER_NUM=64
CONFIG_ESP_WIFI_MGMT_SBUF_NUM=32

# 关掉省电，否则 modem sleep 期间收不到任何探测帧
# CONFIG_PM_ENABLE is not set

# LVGL：用 Kconfig 作为配置来源（不提供 lv_conf.h）
CONFIG_LV_CONF_SKIP=y
# 单色屏只保留点阵字体，抗锯齿字体会糊
CONFIG_LV_FONT_UNSCII_8=y
CONFIG_LV_FONT_UNSCII_16=y
```
